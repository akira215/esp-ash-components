## matter/Kconfig.matter
```kconfig
menu "Matter Device"
    
    config ROOT_NODE_NAME
        string "Root node name"
        default "Root Label Name"
        help
            Maximum 33 characters

    config K_TIMEOUT
        int "Commissioning window timeout in seconds"
        range 0 65000
        default 300
        help
            This is the duration of the commissioning window after resetting to factory state
endmenu
```

## modbus/Kconfig.mb
```kconfig
menu "Modbus Configuration"

   config MB_UART_DEBUG
        bool "Enable debugging Modbus message on terminal"
        default n
        help
            Modbus HEX frame will be outputed on terminal

endmenu
```

## zigbee/Kconfig.zb
```kconfig
menu "Zigbee Device"
    
 
    config ZB_STACK_DEPTH
        int "Stack depth for Zigbee task"
        range 2048 8192
        default 4096
        help
            Use uxTaskGetStackHighWaterMark(ZbNode::getInstance()->getZbTask())
            to check remaining available stack.

endmenu
```
